## components/blink/Kconfig
```kconfig
menu "Visible LED Configuration"

    choice BLINK_LED
        prompt "Blink LED type"
        default BLINK_LED_RMT if IDF_TARGET_ESP32C3
        default BLINK_LED_RMT if IDF_TARGET_ESP32S2
        default BLINK_LED_GPIO
        help
            Defines the default peripheral for blink example

        config BLINK_LED_GPIO
            bool "GPIO"
        config BLINK_LED_RMT
            bool "RMT - Addressable LED"
	config BLINK_LED_NONE
	    bool "No LED pilot light"
    endchoice

    config BLINK_LED_RMT_CHANNEL
        depends on BLINK_LED_RMT
        int "RMT Channel"
        range 0 7
        default 0
        help
            Set the RMT peripheral channel.
            ESP32 RMT channel from 0 to 7
            ESP32-S2 RMT channel from 0 to 3
            ESP32-C3 RMT channel from 0 to 1

    config BLINK_GPIO
        depends on !BLINK_LED_NONE
        int "Blink GPIO number"
        range 0 34
        default 8 if IDF_TARGET_ESP32C3
        default 18 if IDF_TARGET_ESP32S2
        default 5
        help
            GPIO number (IOxx) to blink on and off or the RMT signal for the addressable LED.
            Some GPIOs are used for other purposes (flash connections, etc.) and cannot be used to blink.
            GPIOs 35-39 are input-only so cannot be used as outputs.

    config BLINK_PERIOD
        depends on !BLINK_LED_NONE
        int "Blink period in ms"
        range 10 3600000
        default 1000 if BLINK_LED_GPIO
	default 500 if BLINK_LED_RMT
        help
            Define the default blinking period in milliseconds.

endmenu
```

## components/command-line/Kconfig
```kconfig
menu "Command Line Interpreter"

    config COMMAND_LINE_ENABLED
        bool "Enable command line"
	default y
	help
	    Enable the command line interpreter

    config COMMAND_LINE_TASK_PRIORITY
        depends on COMMAND_LINE_ENABLED
        int "Command Line Task Priority Value"
        range 0 32
        default 5
        help
            Task priority value of the command line interpreter (0 is lowest)

    config COMMAND_LINE_STACK_SIZE
        depends on COMMAND_LINE_ENABLED
        hex "Command Line Task Stack Size"
        default 0x4000
        help
            Stack size for the command line interpreter, must account for the work done by
	    any/all of the individual commands that might be implemented.

endmenu
```

## sdkconfig.defaults
```kconfig
# needed for the extended "tasks" command
CONFIG_FREERTOS_GENERATE_RUN_TIME_STATS=y

CONFIG_BT_ENABLED=y
CONFIG_BT_NIMBLE_ENABLED=y
```
